## conf/distro/emlinux.conf
```bitbake
# Distro Layer configuration
# include and overwrite default poky distro
include conf/distro/poky.conf
DISTRO = "emlinux"
DISTRO_NAME = "Embedded-Linux"
DISTRO_VERSION = "1.0"
DISTRO_CODENAME = "Rambo"
SDK_VENDOR = "-emlinux-sdk"
SDK_VERSION="${DISTRO_VERSION}"
MAINTAINER = "info@mydistro.com"

TARGET_VENDOR = "-emlinux"

# Override these in poky based distros
EMLINUX_DEFAULT_DISTRO_FEATURES = ""
EMLINUX_DEFAULT_EXTRA_RDEPENDS = "packagegroup-core-boot"
EMLINUX_DEFAULT_EXTRA_RRECOMMENDS = "kernel-module"

DISTRO_EXTRA_RDEPENDS += " ${EMLINUX_DEFAULT_EXTRA_RDEPENDS}"
DISTRO_EXTRA_RRECOMMENDS += " ${EMLINUX_DEFAULT_EXTRA_RRECOMMENDS}"

DISTRO_FEATURES ?= "${EMLINUX_DEFAULT_DISTRO_FEATURES} ${DISTRO_FEATURES_LIBC} "

PACKAGE_CLASSES = "package_rpm"

# Use systemd as init manager
#DISTRO_FEATURES_append = " systemd"
#DISTRO_FEATURES_BACKFILL_CONSIDERED += "sysvinit"
VIRTUAL-RUNTIME_dev_manager = "busybox-mdev"
VIRTUAL-RUNTIME_init_manager = "sysvinit"
VIRTUAL-RUNTIME_initscripts = "initscripts"
```

## conf/layer.conf
```bitbake
# We have a conf and classes directory, add to BBPATH
BBPATH .= ":${LAYERDIR}"

# We have recipes-* directories, add to BBFILES
BBFILES += "${LAYERDIR}/recipes-*/*/*.bb \
            ${LAYERDIR}/recipes-*/*/*.bbappend"

BBFILE_COLLECTIONS += "meta-hhc7510"
BBFILE_PATTERN_meta-hhc7510 = "^${LAYERDIR}/"
BBFILE_PRIORITY_meta-hhc7510 = "6"

LAYERDEPENDS_meta-hhc7510 = "core"
#LAYERSERIES_COMPAT_meta-hhc7510 = "thud"
```

## conf/machine/hhc7510.conf
```bitbake
#@TYPE: Machine
#@NAME: arm_versatile_926ejs
#@DESCRIPTION: arm_versatile_926ejs

require conf/machine/include/tune-arm926ejs.inc
#require conf/machine/include/tune-arm1136jf-s.inc

KERNEL_IMAGETYPE = "uImage"

SERIAL_CONSOLES ?= "115200;ttyS0 115200;"
```
